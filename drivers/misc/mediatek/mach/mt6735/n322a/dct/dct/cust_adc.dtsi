/*
 * Generated by MTK SP DrvGen Version 03.13.6 for MT6753. Copyright MediaTek Inc. (C) 2013.
 * Sat Jun 27 16:09:47 2015
 * Do Not Modify the File.
 */

/********************************************
 *ADC DTSI File
********************************************/

&auxadc {
	AUXADC@ {
		compatible = "mediatek, AUXADC_CH";
		TEMPERATURE = <0>;
		TEMPERATURE1 = <1>;
		ADC_FDD_RF_PARAMS_DYNAMIC_CUSTOM_CH = <12>;
	};
};
