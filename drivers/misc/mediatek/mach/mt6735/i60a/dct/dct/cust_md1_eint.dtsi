/*
 * Generated by MTK SP DrvGen Version 03.13.6 for MT6753. Copyright MediaTek Inc. (C) 2013.
 * Thu Nov 05 22:03:51 2015
 * Do Not Modify the File.
 */

/*********************************************
 *MD EINT DTSI File
*********************************************/

&eintc {
	MD1_SIM1_HOT_PLUG_EINT@0 {
		compatible = "mediatek, MD1_SIM1_HOT_PLUG_EINT-eint";
		interrupts = <0 4>;
		debounce = <0 0>;
		dedicated = <0 0>;
		src_pin = <0 2>;
		sockettype=<0 0>;
	};

};
