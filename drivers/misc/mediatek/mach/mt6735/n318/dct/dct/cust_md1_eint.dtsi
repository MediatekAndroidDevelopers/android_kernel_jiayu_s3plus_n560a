/*
 * Generated by MTK SP DrvGen Version 03.13.6 for MT6753. Copyright MediaTek Inc. (C) 2013.
 * Wed May 27 22:13:36 2015
 * Do Not Modify the File.
 */

/*********************************************
 *MD EINT DTSI File
*********************************************/

&eintc {
	MD1_SIM1_HOT_PLUG_EINT@0 {
		compatible = "mediatek, MD1_SIM1_HOT_PLUG_EINT-eint";
		interrupts = <0 8>;
		debounce = <0 100000>;
		dedicated = <0 0>;
		src_pin = <0 1>;
		sockettype=<0 0>;
	};

	MD1_SIM2_HOT_PLUG_EINT@1 {
		compatible = "mediatek, MD1_SIM2_HOT_PLUG_EINT-eint";
		interrupts = <1 8>;
		debounce = <1 100000>;
		dedicated = <1 0>;
		src_pin = <1 2>;
		sockettype=<1 0>;
	};

};
